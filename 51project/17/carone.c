#include "reg52.h"
#include <intrins.h>
 
#define BZ 1
#define XJ 2
#define GS 3
 
sfr AUXR = 0x8E;
 
//sg90
sbit sg90 = P2^5;
//ultrasonic
sbit Trig = P2^3;
sbit Echo = P2^4;
//oled
sbit scl = P2^6;
sbit sda = P2^7;
//car
sbit left_con1A = P1^1;
sbit left_con2A = P1^2;
sbit right_con1A = P1^3;
sbit right_con2A = P1^4;
//循迹
sbit tracingLeft = P1^5;
sbit tracingRight = P1^6;
//跟随
sbit followLeft = P2^1;
sbit followRight = P2^2;
//su-03t
sbit A25 = P0^1;
sbit A26 = P0^2;
sbit A27 = P0^3;
 
int angle;
int angleBack;
int cnt = 0;
 
double leftDistance;
double rightDistance;
double middleDistance;
 
//OLED的字符构造点阵
const unsigned char code oledFont[]=
{
  0x00,0x00,0x00,0x00,0x00,0x00,0x00,0x00,0x00,0x00,0x00,0x00,0x00,0x00,0x00,0x00,// 0
  0x00,0x00,0x00,0xF8,0x00,0x00,0x00,0x00,0x00,0x00,0x00,0x33,0x30,0x00,0x00,0x00,//! 1
  0x00,0x10,0x0C,0x06,0x10,0x0C,0x06,0x00,0x00,0x00,0x00,0x00,0x00,0x00,0x00,0x00,//" 2
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  0x00,0x06,0x01,0x01,0x02,0x02,0x04,0x04,0x00,0x00,0x00,0x00,0x00,0x00,0x00,0x00,//~ 94
};
 
void Delay5us()		//@11.0592MHz
{
}
  
void Delay10us()		//@11.0592MHz
{
	unsigned char i;
 
	i = 2;
	while (--i);
}
 
void Delay100ms()		//@11.0592MHz
{
	unsigned char i, j;
 
	i = 180;
	j = 73;
	do
	{
		while (--j);
	} while (--i);
}
 
void Delay300ms()		//@11.0592MHz
{
	unsigned char i, j, k;
 
	_nop_();
	i = 3;
	j = 26;
	k = 223;
	do
	{
		do
		{
			while (--k);
		} while (--j);
	} while (--i);
}
 
void Delay500ms()		//@11.0592MHz
{
	unsigned char i, j, k;
 
	_nop_();
	i = 4;
	j = 129;
	k = 119;
	do
	{
		do
		{
			while (--k);
		} while (--j);
	} while (--i);
}
 
//sg90
void timer0Init()
{
	//设置定时器0为16为计时模式
	TMOD &=0xF0; 
	TMOD |=0x01; 
 
	//设置定时器0定时时间为0.5ms
	TH0 = 0xFE;
	TL0 = 0x33;
 
	TR0 = 1;  //定时器0开始计时
	TF0 = 0;  //不执行定时器0爆表时导致的中断
 
	ET0 = 1;  //定时器0中断开关
	EA = 1;  //总中断开关
}
 
void sg90Left()
{
	angle = 5;  //180°
	if(angleBack != angle){  
		cnt = 0;
	}
	angleBack = angle;
	Delay100ms();
} 
 
void sg90Middle()
{
	angle = 3;  //90°
	if(angleBack != angle){  
		cnt = 0;
	}
	angleBack = angle;
	Delay100ms();
} 
 
void sg90Right()
{
	angle = 1;  //0°
	if(angleBack != angle){  
		cnt = 0;
	}
	angleBack = angle;
	Delay100ms();
}
 
//ultrasonic
void timer1Init()
{	
	//设置定时器1为16为计时模式
	TMOD &= 0x0F;
	TMOD |= 0x10;  
 
	TH1 = 0x00;
	TL1 = 0x00;
}
 
void ultrasonicStart()
{
	Trig = 0;
	Trig = 1;
	Delay10us();
	Trig = 0; 
}
 
double getDistance()
{
	double time = 0;
	
	//定时器1清0
	TH1 = 0x00;
	TL1 = 0x00;
 
	ultrasonicStart();
		
	while(Echo == 0);  //当Echo引脚从低电平跳到高电平时开启定时器1
	TR1 = 1;
		
	while(Echo == 1);  //当Echo引脚从高电平跳到低电平时关闭定时器1
	TR1 = 0;
 
	time = (TH1*256 + TL1) * 1.085;  //微秒
 
	return (time * 0.017);
}
 
//oled
//IIC起始信号
void IIC_start()
{
	sda = 0;
	scl = 1;
	sda = 1;
	Delay5us();
	sda = 0;
	Delay5us();
	scl = 0;
}
 
//IIC终止信号
void IIC_stop()
{
	scl = 0;
	sda = 0;
	scl = 1;
	Delay5us();
	sda = 1;
	Delay5us();
	sda = 0;
}
 
//IIC的ACK应答信号
char IIC_ack()
{
	char flag;
 
	scl = 0;
	sda = 1;  //在时钟脉冲9期间释放数据线
	Delay5us();  //延时5微秒后，为读取sda数据做准备
 
	scl = 1;  
	Delay5us();  
	flag = sda;  //读取数据线,0为应答
	Delay5us();  
	
	scl = 0;
	Delay5us();
	return flag;
}
 
//IIC发送一个字节
void IIC_sendByte(char myData)
{
	int i;
	for ( i = 0; i < 8; i++){
		//发生数据翻转，选择即将发送的是0还是1
		scl = 0;
		sda = myData & 0x80;  //获取需要发送字节的最高位到SDA
		Delay5us();  //数据建立时间
		
		//开始发送数据
		scl = 1;
		Delay5us();  //数据发送时间
		
		scl = 0;  //发送完毕拉低，等待下1bit数据的传输
		Delay5us();
		
		myData = myData << 1;
	}	
}
 
//OLED写入一条指令
void oledWriteCmd(char writeCmd)
{
	IIC_start();
	IIC_sendByte(0x78);  //选择一个OLED屏，写模式
	IIC_ack();
	IIC_sendByte(0x00);  //写入命令，D/C位为0
	IIC_ack();
	IIC_sendByte(writeCmd);
	IIC_ack();
	IIC_stop();
}
 
//OLED写入一个数据
void oledWriteData(char writeData)
{
	IIC_start();
	IIC_sendByte(0x78);  //选择一个OLED屏，写模式
	IIC_ack();
	IIC_sendByte(0x40);  //写入命令，D/C位为0
	IIC_ack();
	IIC_sendByte(writeData);
	IIC_ack();
	IIC_stop();
}
 
//OLCD初始化
void oledInit()
{
	oledWriteCmd(0xAE);
	oledWriteCmd(0x00);
	oledWriteCmd(0x10);
	oledWriteCmd(0x40);
	oledWriteCmd(0xB0);
	oledWriteCmd(0x81);
	oledWriteCmd(0xFF);
	oledWriteCmd(0xA1);
	oledWriteCmd(0xA6);
	oledWriteCmd(0xA8);
	oledWriteCmd(0x3F);
	oledWriteCmd(0xC8);
	oledWriteCmd(0xD3);
	oledWriteCmd(0x00);
	oledWriteCmd(0xD5);
	oledWriteCmd(0x80);
	oledWriteCmd(0xD8);
	oledWriteCmd(0x05);
	oledWriteCmd(0xD9);
	oledWriteCmd(0xF1);
	oledWriteCmd(0xDA);
	oledWriteCmd(0x12);
	oledWriteCmd(0xDB);
	oledWriteCmd(0x30);
	oledWriteCmd(0x8D);
	oledWriteCmd(0x14);
	oledWriteCmd(0xAF);
}
 
//OLED清屏函数
void olceClean()
{
	int i,j;
	for(i=0;i<8;i++){
		oledWriteCmd(0xB0 + i);  //选择PAGE
		//选择PAGE的第0列开始显示
		oledWriteCmd(0x00);  
		oledWriteCmd(0x10);
		for(j = 0;j < 128; j++){
			oledWriteData(0);  //写入字符0
		}
	}
}
 
//OLED显示一个字符
void oledShowByte(char rows,char columns,char oledByte)
{ 
	unsigned int i;
 
	//显示字符的上半部分
	oledWriteCmd(0xb0+(rows*2-2));  //选择行
	//选择列                        
	oledWriteCmd(0x00+(columns&0x0f));                          
	oledWriteCmd(0x10+(columns>>4));      
	//显示数据                       
	for(i=((oledByte-32)*16);i<((oledByte-32)*16+8);i++){
		oledWriteData(oledFont[i]);                            
	}
 
 	//显示字符的上半部分
	oledWriteCmd(0xb0+(rows*2-1));  //选择行  
	//选择列                    
	oledWriteCmd(0x00+(columns&0x0f));                          
	oledWriteCmd(0x10+(columns>>4)); 
	//显示数据                           
	for(i=((oledByte-32)*16+8);i<((oledByte-32)*16+8+8);i++){
		oledWriteData(oledFont[i]);                            
	}       
}
 
//OLED显示一个字符串
void oledShowString(char rows,char columns,char *str)
{
	while(*str != '\0'){
		oledShowByte(rows,columns,*str);
		str++;
		columns += 8;   
	}       
}
 
//car
//两个电机反转，前进
void goForward()
{
	left_con1A = 1;
	left_con2A = 0;
	
	right_con1A = 1;	
	right_con2A = 0;
}
 
//两个电机正转，后退
void goBack()
{
	left_con1A = 0;
	left_con2A = 1;
	
	right_con1A = 0;	
	right_con2A = 1;
}
 
//两个电机不转，停止
void goStop()
{
	left_con1A = 0;
	left_con2A = 0;
	
	right_con1A = 0;	
	right_con2A = 0;
}
 
//左电机不转，右电机反转，左转
void goLeft()
{
	left_con1A = 0;
	left_con2A = 0;
	
	right_con1A = 1;	
	right_con2A = 0;
}
 
//左电机反转，右电机不转，右转
void goRight()
{
	left_con1A = 1;
	left_con2A = 0;
 
	right_con1A = 0;	
	right_con2A = 0;
}
 
//循迹模式
void tracingMode()
{	
	if(tracingLeft == 0 && tracingRight == 0){  
		goForward();
	}
 
	if(tracingLeft == 0 && tracingRight == 1){
		goRight();
	}
 
	if(tracingLeft == 1 && tracingRight == 0){
		goLeft();
	}
 
	if(tracingLeft == 1 && tracingRight == 1){
		goStop();
	}
}
 
//跟随模式
void followMode()
{	
	if(followLeft == 0 && followRight == 0){  //
		goForward();
	}
 
	if(followLeft == 0 && followRight == 1){
		goRight();
	}
 
	if(followLeft == 1 && followRight == 0){
		goLeft();
	}
 
	if(followLeft == 1 && followRight == 1){
		goStop();
	}
}
 
//避障模式
void avoidMode()
{
	sg90Middle();
    Delay300ms();
    middleDistance = getDistance();
    if(middleDistance > 35){
        goForward();
    }else{
        goStop();
 
        sg90Left();
        Delay300ms();
        leftDistance = getDistance();
 
        sg90Middle();
        Delay300ms();
 
        sg90Right();
        Delay300ms();
        rightDistance = getDistance();
 
        if(leftDistance < 15 && rightDistance < 15){
            goBack();
            Delay500ms();
            goStop();
        }else{
 
            if(leftDistance > rightDistance){
                goLeft();
                Delay500ms();
                goStop();
            }
 
            if(rightDistance > leftDistance){
                goRight();
                Delay500ms();
                goStop();
            }
        }
    }
}
 
void main()
{
	int mark = 0;
	timer0Init();
	timer1Init();
	sg90Middle();
	Delay500ms();
	oledInit();
	olceClean();
	oledShowString(2,5,"haozige");
	while(1){
 
		if(A25 == 0 && A26 == 1 && A27 == 1){
			if(mark != GS){
				olceClean();
				oledShowString(2,5,"genshuai");
			}
			mark = GS;
			followMode();	
		}
 
 
		if(A25 == 1 && A26 == 0 && A27 == 1){
			if(mark != BZ){
				olceClean();
				oledShowString(2,5,"bizhang");
			}
			mark = BZ;
			avoidMode();	
		}
 
		if(A25 == 1 && A26 == 1 && A27 == 0){
			if(mark != XJ){
				olceClean();
				oledShowString(2,5,"xunji");
			}
			mark = XJ;
			tracingMode();	
		}
 
	}
}
 
//定时器0的中断函数
void Time0Handler() interrupt 1
{
	
	TH0 = 0xFE;
	TL0 = 0x33;
	cnt++;
	//控制占空比
	if(cnt < angle){
		sg90 = 1;
	}else{
		sg90 = 0;
	}
 
	if(cnt == 40){  //每个周期为20ms
		cnt = 0;
		sg90 = 1;
	}
}